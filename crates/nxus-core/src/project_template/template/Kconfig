## crates/nxus-core/src/project_template/template/Kconfig
```kconfig
menu "__ZAPPY_PROJECT_NAME__ applications"

    source "$APPSDIR/external/app/Kconfig"
    source "$APPSDIR/external/test/host/Kconfig"

endmenu
```

## crates/nxus-core/src/project_template/template/app/Kconfig
```kconfig
# app/blinky/Kconfig
config __ZAPPY_PROJECT_NAME_SCREAMING__
	tristate "__ZAPPY_PROJECT_NAME__ app"
	default n

if __ZAPPY_PROJECT_NAME_SCREAMING__

config __ZAPPY_PROJECT_NAME_SCREAMING___PROGNAME
	string "Program name"
	default "__ZAPPY_PROJECT_NAME_SNAKE__"
	---help---
		Name of the command as exposed to NSH.

config __ZAPPY_PROJECT_NAME_SCREAMING___PRIORITY
	int "Task priority"
	default 100
	---help---
		Priority used when NSH starts the blinky app.

config __ZAPPY_PROJECT_NAME_SCREAMING___STACKSIZE
	int "Stack size"
	default DEFAULT_TASK_STACKSIZE
	---help---
		Stack size used by the blinky task.

endif
```

## crates/nxus-core/src/project_template/template/test/host/Kconfig
```kconfig
config __ZAPPY_PROJECT_NAME_SCREAMING___TEST_HOST
	tristate "__ZAPPY_PROJECT_NAME__ host tests"
	default n
    depends on TESTING_UNITY
    depends on TESTING_UNITY_EXCLUDE_SETJMP
    depends on TESTING_UNITY_PRINT_FORMATTED
    ---help---
        Unity-based host tests for __ZAPPY_PROJECT_NAME__
```
